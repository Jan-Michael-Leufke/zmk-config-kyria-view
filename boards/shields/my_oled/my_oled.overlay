&i2c1 {
    ssd1306_128x64: ssd1306_128x64@3c {
        compatible = "solomon,ssd1306fb";
        reg = <0x3c>;
        label = "SSD1306";
        width = <128>;
        height = <64>;
        segment-offset = <0>;
        page-offset = <0>;
        display-offset = <0>;
        multiplex-ratio = <63>;
        segment-remap;
        com-invdir;
        prechargep = <0xF1>;
        // Remove or adjust reset-gpios if not used:
        // reset-gpios = <&gpio0 2 GPIO_ACTIVE_LOW>;
    };
};